## boards/derdalaba/leucht-ohrringe/Kconfig.leucht-ohrringe
```kconfig
config BOARD_LEUCHT_OHRRINGE
    bool "leucht-ohrringe"
	select SOC_NRF52832_QFAA
	select ARM
```

## boards/derdalaba/leucht-ohrringe/board.yml
```yaml
board:
  name: leucht-ohrringe
  full_name: leucht-ohrringe
  vendor: derdalaba
  socs:
    - name: nrf52832
```
